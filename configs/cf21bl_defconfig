## configs/cf21bl_defconfig
```kconfig
CONFIG_PLATFORM_CF21BL=y

CONFIG_MOTORS_REQUIRE_ARMING=y
CONFIG_MOTORS_ESC_PROTOCOL_DSHOT=y

CONFIG_DECK_LOCO_FULL_TX_POWER=y

CONFIG_DECK_FORCE="bcTeensy"
CONFIG_DECK_TEENSY=y
```

## configs/sysid_defconfig
```kconfig
CONFIG_DECK_FORCE="bcRpm:bcACS37800:bcLoadcell"
CONFIG_DECK_SYSTEM_ID=y
CONFIG_ENABLE_THRUST_BAT_COMPENSATED=n
```
